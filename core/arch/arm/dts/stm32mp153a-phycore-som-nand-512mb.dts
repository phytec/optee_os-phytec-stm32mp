// SPDX-License-Identifier: (GPL-2.0+ OR BSD-3-Clause)
/*
 * Copyright (C) 2020 PHYTEC Messtechnik GmbH
 * Author: Dom Vovard <dom.vovard@linrt.com>
 *	   Christophe Parant <c.parant@phytec.fr>
 */

/dts-v1/;

/* ATF Specific */
#include <dt-bindings/clock/stm32mp1-clksrc.h>
#include <dt-bindings/power/stm32mp1-power.h>
#include "stm32mp153.dtsi"
#include "stm32mp15xa.dtsi"
#include "stm32mp15xx-phycore-som.dtsi"

/ {
	model = "PHYTEC phyCORE-STM32MP153A with NAND and 512MB RAM";
	compatible = "phytec,stm32mp153a-phycore-som-nand-512mb",
		     "phytec,stm32mp153a-phycore-som.dtsi", "st,stm32mp153";

	memory@c0000000 {
		device_type = "memory";
		reg = <0xc0000000 0x20000000>;
	};
};
